## modules/debounce/Kconfig
```kconfig
config MILESTONE2_DEBOUNCE
        tristate "Milestone2 keyboard debounce fix"
        default m
```

## modules/sources/qtouch_num/Kconfig
```kconfig
config QTOUCH_MULTITOUCH
        tristate "Multitouch 1 to 10 points for MM2"
        default m
```
